## CMakeLists.txt
```
cmake_minimum_required(VERSION 3.20.0)

# add_definitions(-DPOSIX_ARCH_DEBUG_PRINTS)

find_package(Zephyr REQUIRED HINTS $ENV{ZEPHYR_BASE})
project(uart_socket_test)

target_sources(app PRIVATE src/main.c)
```

## prj.conf
```kconfig
CONFIG_NEWLIB_LIBC=y
CONFIG_HEAP_MEM_POOL_SIZE=10240
CONFIG_NANOPB_ENABLE_MALLOC=y
CONFIG_NANOPB=y

CONFIG_SERIAL=y
CONFIG_UART_INTERRUPT_DRIVEN=y
# CONFIG_UART_NATIVE_POSIX=y
# CONFIG_UART_NATIVE_POSIX_PORT_1_ENABLE=y

CONFIG_SHELL=y

CONFIG_RING_BUFFER=y
CONFIG_NATIVE_POSIX_SLOWDOWN_TO_REAL_TIME=y
CONFIG_DEBUG=y
```

## boards/native_posix.overlay
```dts
/ {
	uart_parent {
		#address-cells = < 1 >;
		#size-cells = < 0 >;

		uart_socket: uart_socket@1e62 {
			compatible = "rumission,uart-socket";
			status = "okay";
			reg = <7778>;
			irqn=<3>;
		};
	};

	chosen {
		zephyr,shell-uart = &uart_socket;
	};
};
```

## src/main.c
```c
#include <zephyr/device.h>

// Attach telnet to the port defined in the devicetree

int main(void)
{
    const struct device *uart_socket = DEVICE_DT_GET(DT_NODELABEL(uart_socket));
    if (device_is_ready(uart_socket))
    {
        printk("UART socket is ready\n");
    }
    else
    {
        printk("UART socket is not ready\n");
    }

    return 0;
}
```
