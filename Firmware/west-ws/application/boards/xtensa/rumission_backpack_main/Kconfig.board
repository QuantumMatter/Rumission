## Firmware/west-ws/application/boards/xtensa/rumission_backpack_main/Kconfig.board
```kconfig
# Copyright (c) 2023 Espressif Systems (Shanghai) Co., Ltd.
# SPDX-License-Identifier: Apache-2.0

config BOARD_RUMISSION_BACKPACK_MAIN
	bool "Rumission Backpack - Main Board"
	depends on SOC_SERIES_ESP32

choice SOC_PART_NUMBER
	default SOC_ESP32_WROVER_E_N8R8
endchoice
```

## Firmware/west-ws/application/drivers/Kconfig
```kconfig
menu "Drivers"
rsource "misc/Kconfig"
rsource "sensor/Kconfig"
rsource "serial/Kconfig"
rsource "rpc/Kconfig"
endmenu
```

## Firmware/west-ws/application/drivers/misc/lmp91000/Kconfig
```kconfig
config LMP91000
    bool "LMP91000"
    default y
    depends on DT_HAS_TI_LMP91000_ENABLED
    help
        Enable LMP91000 AFE
```

## Firmware/west-ws/application/drivers/misc/pam/Kconfig
```kconfig
config PAM
    bool "PAM"
    default y
    depends on DT_HAS_TWOBTECH_PAM_ENABLED
    help
        Enable interface to 2B's PAM
```

## Firmware/west-ws/application/drivers/rpc/Kconfig
```kconfig
config RPC
    bool "RPC"
    default y
    help
        Enables RPC support

rsource "rpc/Kconfig"
rsource "i2c_rpc/Kconfig"
rsource "uart_rpc/Kconfig"
```

## Firmware/west-ws/application/drivers/rpc/i2c_rpc/Kconfig
```kconfig
config I2C_RPC
    bool "I2C_RPC"
    default y
    depends on DT_HAS_RUMISSION_I2C_RPC_ENABLED
    help
        Support for an I2C target that implements the RPC
        protocol we have defined

config I2C_RPC_RX_PERIOD
    int "I2C RPC RX period (ms)"
    default 100
    help
        The period at which the I2C RPC driver will poll
        for incoming messages

config I2C_RPC_RX_STACK_SIZE
    int "I2C RPC RX stack size"
    default 4096
    help
        The stack size for the I2C RPC RX thread

config I2C_RPC_RX_PRIORITY
    int "I2C RPC RX priority"
    default 10
    help
        The priority for the I2C RPC RX thread
```

## Firmware/west-ws/application/drivers/rpc/rpc/Kconfig
```kconfig
config RPC_DEVICE
    bool "RPC Device"
    default y
    depends on DT_HAS_RUMISSION_RPC_ENABLED
    help
        Provides support for instantiating the RPC module in the Device Tree
```

## Firmware/west-ws/application/drivers/rpc/uart_rpc/Kconfig
```kconfig
config UART_RPC
    bool "UART_RPC"
    default y
    depends on DT_HAS_RUMISSION_UART_RPC_ENABLED
    help
        Support for an UART device that implements the RPC
        protocol we have defined

config UART_RPC_BUFFER_LENGTH
    int "Length of the UART ring buffers"
    depends on UART_RPC
    default 1024
    help
        This option sets the length of the UART ring buffers
        used for sending and receiving data

config UART_RPC_RX_STACK_SIZE
    int "Size of the UART RPC RX thread stack"
    depends on UART_RPC
    default 4096
    help
        This option sets the size of the UART RPC RX thread stack

config UART_RPC_RX_PRIORITY
    int "Priority of the UART RPC RX thread"
    depends on UART_RPC
    default 8
    help
        This option sets the priority of the UART RPC RX thread
```

## Firmware/west-ws/application/drivers/sensor/axetris/Kconfig
```kconfig
config AXETRIS
    bool "AXETRIS"
    default y
    depends on DT_HAS_AXETRIS_AXETRIS_ENABLED
    help
        Enable Axetris LGD Methane Sensor
```

## Firmware/west-ws/application/drivers/sensor/flow/Kconfig
```kconfig
config FLOW_METER
    bool "Flow Meter"
    default y
    depends on DT_HAS_RUMISSION_FLOW_METER_ENABLED
    help
        Enable the flow meter peripheral
```

## Firmware/west-ws/application/drivers/sensor/hih8xxx/Kconfig
```kconfig
config HIH8XXX
    bool "HIH8XXX"
    default y
    depends on DT_HAS_HONEYWELL_HIH8XXX_ENABLED
    help
        Enable Honeywell HIH8xxx Temperature and Humidity sensor
```

## Firmware/west-ws/application/drivers/serial/Kconfig
```kconfig
config UART_SOCKET
    bool "UART_SOCKET"
    default y
    depends on DT_HAS_RUMISSION_UART_SOCKET_ENABLED
	select SERIAL_HAS_DRIVER
	imply SERIAL_SUPPORT_INTERRUPT
	imply UART_INTERRUPT_DRIVEN
    help
        Emulated UART interface backed by a Unix Socket
```

## Firmware/west-ws/application/dts/bindings/misc/ti,lmp91000.yml
```yaml
description: |
    The LMP91000 is a programmable analog front-end (AFE)
    for use in micro-power electrochemical sensing
    applications. It provides a complete signal path solution
    between a sensor and a microcontroller that generates an
    output voltage proportional to the cell current

compatible: "ti,lmp91000"

include:
    - base.yaml
    - i2c-device.yaml

# properties:
```

## Firmware/west-ws/application/dts/bindings/misc/twobtech,pam.yml
```yaml
description: |
  The Portable Air Quality Monitor from 2B Technologies

compatible: "twobtech,pam"

include:
    - base.yaml
    - rpc.yml
```

## Firmware/west-ws/application/dts/bindings/rpc/rpc.yml
```yaml
properties:
  hw:
    type: phandle
    description: |
      The node that handles the device's I/O.
```

## Firmware/west-ws/application/dts/bindings/rpc/rumission,i2c-rpc.yml
```yaml
description: |
  The RPC device is a device that allows to send and receive RPC messages
  over a serial interface.

compatible: "rumission,i2c-rpc"

include:
  - base.yaml

properties:
 rpc:
    type: phandle
    description: |
      The RPC device that should receive the messages.
```

## Firmware/west-ws/application/dts/bindings/rpc/rumission,rpc.yml
```yaml
description: |
  The RPC device is a device that allows to send and receive RPC messages
  over a serial interface.

compatible: "rumission,rpc"

include:
  - base.yaml

properties:
  bus_id:
    type: int
    description: |
      The ID of this RPC device.
```

## Firmware/west-ws/application/dts/bindings/rpc/rumission,uart-rpc.yml
```yaml
description: |
  The RPC device is a device that allows to send and receive RPC messages
  over a serial interface.

compatible: "rumission,uart-rpc"

include:
  - base.yaml

properties:
 rpc:
    type: phandle
    description: |
      The RPC device that should receive the messages.
      
```

## Firmware/west-ws/application/dts/bindings/sensor/axetris,axetris.yml
```yaml
description: |
  The Axetris is a Methane sensor

compatible: "axetris,axetris"

include:
  - sensor-device.yaml
  - uart-device.yaml

properties:
  input-gpios:
    type: phandle-array
    required: true
    description: |
      Indicators if the RS232 translator says the bus is ok
```

## Firmware/west-ws/application/dts/bindings/sensor/honeywell,hih8xxx.yml
```yaml
description: |
  Temperature and humidity sensor

compatible: "honeywell,hih8xxx"

include:
  - base.yaml
  - sensor-device.yaml
  - i2c-device.yaml
```

## Firmware/west-ws/application/dts/bindings/sensor/rumission,flow-meter.yml
```yaml
description: |
    The flow meter is a device that measures the flow rate of a gas or liquid.

compatible: "rumission,flow-meter"

include:
    - base.yaml
    - rpc.yml
```

## Firmware/west-ws/application/dts/bindings/serial/rumission,uart-socket.yml
```yaml
description: UART over unix Socket

compatible: "rumission,uart-socket"

include: [uart-controller.yaml]

properties:
  reg:
    description: |
      Specifies which port to use for the socket

  irqn:
    type: int
    description: |
      Specifies which interrupt to use for the socket
```
