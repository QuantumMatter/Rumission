## Firmware/west-ws/application/lib/rpc/Kconfig
```kconfig
config RPC_LIB
    bool "RPC Support"
    

config RPC_TARGET_COUNT
    int "Maximum number of RPC clients/servers"
    depends on RPC_LIB
    default 4
    help
      This option sets the maximum number of RPC clients and servers
      that can be registered at any one time.

config RPC_CONCURRENT_REQUESTS
    int "Maximum number of concurrent RPC requests"
    depends on RPC_LIB
    default 4
    help
      This option sets the maximum number of concurrent RPC requests
      that can be handled at any one time. Maximum is 32

config RPC_FUNCTION_COUNT
    int "Maximum number of RPC functions"
    depends on RPC_LIB
    default 8
    help
      This option sets the maximum number of RPC functions that can
      be registered at any one time.
```

## Firmware/west-ws/application/west.yml
```yaml
manifest:

  remotes:
    - name: zephyrproject-rtos
      url-base: https://github.com/zephyrproject-rtos

  projects:
    - name: zephyr
      remote: zephyrproject-rtos
      revision: main
      import:
        # By using name-allowlist we can clone only the modules that are
        # strictly needed by the application.
        name-allowlist:
          - hal_espressif
          - hal_xtensa
          - mcuboot
          - nanopb
```
